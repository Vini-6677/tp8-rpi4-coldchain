## br2-external/Config.in
```kconfig
menu "Web-Server Cold Chain Custom Packages"
# Pacotes customizados futuros
endmenu
```

## br2-external/configs/tp8_raspberrypi4_defconfig
```kconfig
BR2_aarch64=y
BR2_cortex_a72=y
BR2_ARM_FPU_VFPV4=y

# Build determinístico e reprodutível
BR2_REPRODUCIBLE=y

# Hostname e Rede
BR2_TARGET_GENERIC_HOSTNAME="coldchain-rpi4"
BR2_SYSTEM_DHCP="eth0"

# Sistema de inicialização
BR2_INIT_BUSYBOX=y

# Overlays
BR2_ROOTFS_OVERLAY="$(BR2_EXTERNAL_TP8_COLDCHAIN_PATH)/board/common/overlay"

# Kernel Raspberry Pi Oficial com fragmento Docker
BR2_LINUX_KERNEL=y
BR2_LINUX_KERNEL_CUSTOM_TARBALL=y
BR2_LINUX_KERNEL_CUSTOM_TARBALL_LOCATION="$(call github,raspberrypi,linux,21b410140c47ffab5668399f6f143c7d7b935c8b)/linux-21b410140c47ffab5668399f6f143c7d7b935c8b.tar.gz"
BR2_LINUX_KERNEL_DEFCONFIG="bcm2711"
BR2_LINUX_KERNEL_CONFIG_FRAGMENT_FILES="$(BR2_EXTERNAL_TP8_COLDCHAIN_PATH)/board/common/kernel-docker.fragment"
BR2_LINUX_KERNEL_DTS_SUPPORT=y
BR2_LINUX_KERNEL_INTREE_DTS_NAME="broadcom/bcm2711-rpi-4-b"
BR2_LINUX_KERNEL_NEEDS_HOST_OPENSSL=y

# Firmware da RPi4
BR2_PACKAGE_RPI_FIRMWARE=y
BR2_PACKAGE_RPI_FIRMWARE_VARIANT_PI4=y

# Runtime Docker e Dependências Obrigatórias (Requisito 5)
BR2_PACKAGE_DOCKER_ENGINE=y
BR2_PACKAGE_DOCKER_CLI=y
BR2_PACKAGE_CONTAINERD=y
BR2_PACKAGE_RUNC=y
BR2_PACKAGE_TINI=y
BR2_PACKAGE_IPTABLES=y

# Ferramentas de Sistema, Rede e Persistência
BR2_PACKAGE_E2FSPROGS=y
BR2_PACKAGE_DROPBEAR=y
BR2_PACKAGE_CHRONY=y
BR2_PACKAGE_AVAHI=y
BR2_PACKAGE_AVAHI_DAEMON=y
BR2_PACKAGE_CA_CERTIFICATES=y

# Partição RootFS ext4 (somente leitura)
BR2_TARGET_ROOTFS_EXT2=y
BR2_TARGET_ROOTFS_EXT2_4=y
BR2_TARGET_ROOTFS_EXT2_SIZE="400M"
# BR2_TARGET_ROOTFS_TAR is not set

# Ferramentas Host para gerar sdcard.img
BR2_PACKAGE_HOST_GENIMAGE=y
BR2_PACKAGE_HOST_DOSFSTOOLS=y
BR2_PACKAGE_HOST_MTOOLS=y
```
